## CMakeLists.txt
```
cmake_minimum_required(VERSION 3.8)
include($ENV{ZEPHYR_BASE}/cmake/app/boilerplate.cmake NO_POLICY_SCOPE)
project(NONE)

target_sources(app PRIVATE src/main.c)
target_sources(app PRIVATE src/zephyr_uart.c)
#target_sources(app PRIVATE src/dl_packet.c)
#target_sources(app PRIVATE src/dl_command.c)
target_sources(app PRIVATE src/uwp_pkt.c)
target_sources(app PRIVATE src/uwp_cmd.c)
target_sources(app PRIVATE src/uwp_intf.c)
target_sources(app PRIVATE src/uwp_flash.c)
```

## Kconfig
```
#
# SPDX-License-Identifier: Apache-2.0
#

mainmenu "UNISOC FDL"

module = FDL
module-dep = LOG
module-str = fdl
module-help = Sets log level for fdl application.
source "subsys/logging/Kconfig.template.log_config"

source "Kconfig.zephyr"

config FDL_DEBUG
	bool "fdl debug"
	default n
	help
	output debug message.
```

## prj.conf
```kconfig
# nothing here

CONFIG_XIP=n
CONFIG_BOOT_BANNER=n
CONFIG_STDOUT_CONSOLE=y
CONFIG_HEAP_MEM_POOL_SIZE=16384

#To enable fdl log output, need 2 procedures:
# 1. set below configs to y
# 2. Change default console to UART_2 in file boards/arm/96b_ivy5661/96b_ivy5661.dts
CONFIG_LOG=n
CONFIG_AON_UART_UWP=n
CONFIG_PRINTK=n
CONFIG_CONSOLE=n
CONFIG_UART_CONSOLE=n

CONFIG_GPIO=n
CONFIG_PINMUX=n
CONFIG_LED=n
CONFIG_WATCHDOG=n
CONFIG_WDT_UWP=n
CONFIG_SIPC=n
```

## src/main.c
```c
/*
 * Copyright (c) 2018, UNISOC Incorporated
 *
 * SPDX-License-Identifier: Apache-2.0
 */

#include "logging/log.h"
LOG_MODULE_REGISTER(FDL);

#include <zephyr.h>

#include "uwp_cmd.h"
#include "uwp_intf.h"

unsigned char debug_mode(void)
{
#ifdef CONFIG_FDL_DEBUG
	return 1;
#else
	return 0;
#endif
}

#define INTF_NAME	"zephyr_uart"
#define DEV_NAME	"UART_0"

void main(void)
{
	int ret;
	LOG_INF("UNISOC FDL.");

	ret = uwp_intf_init(INTF_NAME, DEV_NAME);
	if (ret) {
		LOG_ERR("Init channel failed.");
		return;
	}
	
	ret = uwp_cmd_init();
	if (ret) {
		LOG_ERR("Init command failed.");
		return;
	}

	LOG_INF("start download...");
}
```

## src/os_hal.h
```c
../../utility/uwpflash/os_hal.h
```

## src/uwp_cmd.c
```c
../../utility/uwpflash/uwp_cmd.c
```

## src/uwp_cmd.h
```c
../../utility/uwpflash/uwp_cmd.h
```

## src/uwp_flash.c
```c
#include "logging/log.h"
LOG_MODULE_DECLARE(FDL);

#include <zephyr.h>
#include <flash.h>
#include <string.h>

#include "uwp_flash.h"

struct device *dev;
#define CONFIG_SYS_LOAD_ADDR	0x120000
#define NORFLASH_ADDRESS 0x2000000
#define MAX_FLASH_SIZE	(64 * 1024)
static u8_t *buf_addr = (u8_t *)CONFIG_SYS_LOAD_ADDR;
static u32_t buf_len = 0;
static u32_t write_offset = 0;
unsigned int image_addr = 0;
unsigned int image_size = 0;

#define FLASH_BY_PIECE

void uwp_flash_set_image_addr(unsigned int addr)
{
	image_addr = addr;
	LOG_INF("image address: %x", addr);

	/* In case of flash operation, it requires the flash offset
	 * for read and wirte operations
	 */
	image_addr -= NORFLASH_ADDRESS;
	write_offset = 0;
	buf_len = 0;
}

void uwp_flash_set_image_size(unsigned int size)
{
	image_size = size;
	LOG_INF("image size: %d", size);
}

int uwp_flash_write(void)
{
	int ret;
	u32_t write_addr;

	if (buf_len == 0) return 0;

#ifdef FLASH_BY_PIECE
	write_addr = image_addr + write_offset;
#else
	write_addr = image_addr;
	if (image_size != buf_len) {
		LOG_ERR("Image length not match.\n");
		return -1;
	}
#endif

	dev = device_get_binding(DT_FLASH_AREA_0_DEV);
	if (dev == NULL) {
		LOG_ERR("Open flash %s failed.", DT_FLASH_AREA_0_DEV);
		return -1;
	}
	flash_write_protection_set(dev, false);

	/* flash write require alligned */
	buf_len = (buf_len + 0xFFF) & ~0xFFF;

	LOG_INF("Erase flash address: 0x%x size: 0x%x.", write_addr, buf_len);

	ret = flash_erase(dev, write_addr, buf_len);
	if (ret) {
		LOG_ERR("Erase flash failed.");
		return -1;
	}
	LOG_INF("Erase success.");

	LOG_INF("Write flash start...");
	ret = flash_write(dev, write_addr, buf_addr, buf_len);
	if (ret) {
		LOG_ERR("wirte flash failed.");
		return -1;
	}
	LOG_INF("Write success.");
	flash_write_protection_set(dev, true);

	write_offset += buf_len;
	buf_len = 0;

	return 0;
}

int uwp_flash_update(u8_t *data, u32_t len)
{
#ifdef FLASH_BY_PIECE
	int ret;

	u32_t used_len = 0;

	if (buf_len + len <= MAX_FLASH_SIZE) {
		memcpy(buf_addr + buf_len, data, len);
		buf_len += len;
	} else {
		used_len = MAX_FLASH_SIZE - buf_len;
		memcpy(buf_addr + buf_len, data,  used_len);
		buf_len = MAX_FLASH_SIZE;

		ret = uwp_flash_write();
		if (ret) return ret;

		return uwp_flash_update(data + used_len, len - used_len);
	}
#else
	memcpy(buf_addr + buf_len, data, len);
	buf_len += len;
#endif

	return 0;
}
```

## src/uwp_flash.h
```c
#ifndef _UWP_FLASH_H_
#define _UWP_FLASH_H_

extern void uwp_flash_set_image_addr(unsigned int addr);
extern void uwp_flash_set_image_size(unsigned int size);
extern int uwp_flash_update(u8_t *data, u32_t len);
extern int uwp_flash_write(void);

#endif
```

## src/uwp_intf.c
```c
../../utility/uwpflash/uwp_intf.c
```

## src/uwp_intf.h
```c
../../utility/uwpflash/uwp_intf.h
```

## src/uwp_pkt.c
```c
../../utility/uwpflash/uwp_pkt.c
```

## src/uwp_pkt.h
```c
../../utility/uwpflash/uwp_pkt.h
```

## src/zephyr_uart.c
```c
/*
 * Copyright (c) 2018, UNISOC Incorporated
 *
 * SPDX-License-Identifier: Apache-2.0
 */

#include "logging/log.h"
LOG_MODULE_DECLARE(FDL);

#include <zephyr.h>
#include <string.h>
#include <uart.h>

#include "uwp_pkt.h"
#include "uwp_cmd.h"
#include "uwp_intf.h"

#define BOOT_FLAG_USB                   (0x5A)
#define BOOT_FLAG_UART1                 (0x6A)
#define BOOT_FLAG_UART0                 (0x7A)

notify_func notify = NULL;
struct device *uart_dev;

static int uart_send(struct uwp_pkt *pkt)
{
    int send;
    unsigned int len = uwp_pkt_size(pkt);
    unsigned char *data = uwp_pkt_data(pkt);

	if ((pkt == NULL) || (uwp_pkt_size(pkt) == 0)) {
        LOG_ERR("invalid uwp packet.\n");
        return -1;
    }

    uwp_pkt_dump(pkt, "UART SEND");

    send = uart_fifo_fill(uart_dev, data, len);
    if (send == len)
        return 0;

    return -1;
}

static int uart_recv(struct uwp_pkt *pkt)
{
	int len;

	uart_irq_update(uart_dev);

	if (uart_irq_rx_ready(uart_dev)) {
		len = uart_fifo_read(uart_dev, uwp_pkt_write_ptr(pkt),
				uwp_pkt_available_len(pkt));

		if (len > 0) {
			uwp_pkt_increase(pkt, len);
			uwp_pkt_dump(pkt, "UART RECV");
			return 0;
		}
	}

	return -1;
}

int uart_init(char *dev)
{
	uart_dev = device_get_binding(dev);
	if (uart_dev == NULL) {
		LOG_ERR("Open device %s failed", dev);
		return -1;
	}

	if (notify != NULL) {
		uart_irq_callback_user_data_set(uart_dev, notify,
				(void *)uart_dev);
		uart_irq_rx_enable(uart_dev);

		LOG_INF("enable interrupt mode.");
	}

	LOG_INF("zephyr uart init success.");

	return 0;
}

int uart_register_notify(notify_func func)
{
    notify = func;
    return 0;
}

struct uwp_intf zephyr_uart_intf = {
	.name = "zephyr_uart",
	.init = uart_init,
	.send = uart_send,
	.recv = uart_recv,
	.register_notify = uart_register_notify,
};
```
